/* source keypos definitions */
#include "../../../zmk-nodefree-config/keypos_def/keypos_42keys.h"

/* map 6 extra keys */
#define X_LT  &mt LS(LC(LALT)) ESC
#define X_LM  &mt RS(RC(RA(RGUI))) TAB
#define X_LB  &kp LCTRL
#define X_RT  &mt RS(RC(RA(RGUI))) DEL
#define X_RM  &kp RALT
#define X_RB  &kp RCTRL

/* activate bluetooth */
#define CONFIG_WIRELESS 1

/* source the main keymap */
#include "../../../base.keymap"

/* use 6-column layout*/
/ { chosen { zmk,matrix_transform = &default_transform; }; };


